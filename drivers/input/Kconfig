## drivers/input/Kconfig
```kconfig
config INPUT_TPS43
    bool "Azoteq TPS43 I2C Touchpad Input Device"
    default y
    depends on I2C
    depends on INPUT
    help
      Enable driver for Azoteq touchpad input device over I2C interface.
      Supports multitouch gestures, scrolling, clicks and power management.

if INPUT_TPS43

config INPUT_TPS43_INIT_PRIORITY
    int "Init priority"
    default 90
    help
      Device driver initialization priority.

config INPUT_TPS43_WORKQUEUE_STACK_SIZE
    int "Trackpad workqueue stack size"
    default 2048
    help
      Stack size (bytes) for the dedicated workqueue that processes trackpad
      reads and emits input events. A dedicated queue (instead of the shared
      system workqueue) ensures that blocking on a full input event queue
      while forwarding events over a BLE split never stalls system-wide work.

endif # ZMK_SENSOR_TPS43
```
